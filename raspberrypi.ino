const unsigned char pico [] PROGMEM = {
  0x00, 0x07, 0xe0, 0x01, 0xf8, 0x00, 0x00, 0x00, 0x7f, 0xf8, 0x07, 0xff, 0x00, 0x00, 0x01, 0xe0, 
  0x1e, 0x1c, 0x01, 0xc0, 0x00, 0x01, 0x80, 0x03, 0x30, 0x00, 0x60, 0x00, 0x01, 0x80, 0x01, 0x20, 
  0x00, 0x60, 0x00, 0x01, 0x80, 0x01, 0xe0, 0x00, 0x60, 0x00, 0x00, 0x80, 0x80, 0xc0, 0x00, 0x40, 
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  0x00, 0x00, 0x0f, 0xfc, 0x00, 0x00, 0x00, 0x00, 0x00, 0x03, 0xf0, 0x00, 0x00, 0x00
};

const unsigned char PROGMEM cs50 [] = {
0x00, 0x00, 0x00, 0x00, 0x00, 0x00, 0x00, 0x00, 0x00, 0x00, 0x00, 0x00, 0x00, 0x00, 0x00, 0x00,
0x00, 0x00, 0x00, 0x00, 0x00, 0x00, 0x00, 0x00, 0x00, 0x00, 0x00, 0x00, 0x00, 0x00, 0x00, 0x00,
0x07, 0xC3, 0xE3, 0xF1, 0xE0, 0x00, 0x00, 0x00, 0x1F, 0xE7, 0x73, 0xF3, 0xF1, 0x82, 0x00, 0x00,
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0x00, 0x00, 0x00, 0x00, 0x00, 0x00, 0x00, 0x00, 0x00, 0x00, 0x00, 0x00, 0x00, 0x00, 0x00, 0x00
};


const unsigned char PROGMEM bituni[]= {
0xFF, 0xF3, 0xFF, 0xFF, 0xFF, 0xFF, 0xC7, 0xFE, 0xFF, 0xF3, 0xFF, 0xFF, 0xFF, 0xFF, 0xCF, 0xFE,
0xFF, 0xF3, 0xFF, 0xFF, 0xFF, 0xFF, 0xCF, 0xFE, 0xFF, 0xF3, 0xFF, 0xFF, 0xFF, 0xFF, 0xCF, 0xFE,
0xFF, 0xF3, 0xFF, 0xFF, 0xFF, 0xFF, 0xCF, 0xFE, 0xFF, 0xF3, 0xFF, 0xFF, 0xFF, 0xFF, 0xCF, 0xFE,
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0x7F, 0xFF, 0xFF, 0xFF, 0xF9, 0xFF, 0xFF, 0xFE, 
};


const unsigned char PROGMEM d [] = {
0x00, 0x00, 0x00, 0x00, 0x00, 0x00, 0x00, 0x00, 0x00, 0x00, 0x00, 0x00, 0x00, 0x00, 0x00, 0x00,
0x00, 0x00, 0xE0, 0x00, 0x00, 0x03, 0xF8, 0x00, 0x00, 0x03, 0xFC, 0x40, 0x00, 0x07, 0xFF, 0xC0,
0x00, 0x07, 0xFF, 0xC0, 0x00, 0x07, 0xEF, 0xE0, 0x00, 0x07, 0xFF, 0xE0, 0x00, 0x07, 0xFF, 0x80,
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0x00, 0x00, 0x00, 0x00, 0x00, 0x00, 0x00, 0x00, 0x00, 0x00, 0x00, 0x00, 0x00, 0x00, 0x00, 0x00
};
 


#include <ZMPT101B.h>

#include <stdio.h>
#include "pico/stdlib.h"
#include "hardware/uart.h"


#include <SPI.h>
#include <Wire.h>
#include <Adafruit_GFX.h>
#include <Adafruit_SSD1306.h>
#include <Adafruit_ADS1015.h>


#define UART_ID uart0
#define BAUD_RATE 115200
#define UART_TX_PIN 16
#define UART_RX_PIN 17

#define SENSITIVITY 614.5f
#define SCREEN_WIDTH 128 // OLED width
#define SCREEN_HEIGHT 64 // OLED height
#define OLED_RESET     -1 // Reset pin # (or -1 if sharing Arduino reset pin)
#define SCREEN_ADDRESS 0x3C ///< See datasheet for Address; 0x3C 
#define addr 0x48

ZMPT101B voltageSensor(26, 60.0);
Adafruit_SSD1306 oled(SCREEN_WIDTH, SCREEN_HEIGHT, &Wire, OLED_RESET);
Adafruit_ADS1115 ads(0x43);


  
const float FACTOR = 100; //30A/1V
const float multiplier = 0.00098F;


unsigned long lastmillis = millis();

float current, voltage, power, kwh=0;

const int led = 1;//led

void uart_rx_callback() {
  while (uart_is_readable(UART_ID)) {
    char data = uart_getc(UART_ID);
    // Hacer algo con los datos recibidos
    if (data == '1') {

      digitalWrite(led, HIGH);
    }
    else {
      digitalWrite(led, LOW);

    }
  }
}

void send_data_uart(float voltage, float current, float power, float kwh) {
    char data[50];
    sprintf(data, "%.2f %.2f %.2f %.2f\n", voltage, current, power, kwh);
    uart_puts(UART_ID, data);
}
/*void timerEvent(){
  
   kwh = kwh + power * (millis() - lastmillis) / 3600000000.0;
  yield();

  
  lastmillis = millis();
  }*/
void myoled(){
  oled.clearDisplay();
  oled.setTextSize(0.5);
  oled.setCursor(10,1);
  oled.print("Created");
  oled.setCursor(20,13);
  oled.print("By");
  oled.setCursor(5,28);
  oled.print("C.Lanuza");
  oled.setCursor(5,40);
  oled.print("J.Chavez");
  oled.setCursor(4, 118);
  oled.print("IoT Meter");
  oled.drawBitmap(0, 60, bituni, 64, 39, WHITE);
  oled.display();
  delay(800);
  
  oled.clearDisplay();
  oled.setRotation(1);
  oled.setTextSize(1);  
  oled.setTextColor(WHITE);
  
  oled.clearDisplay();
  oled.setRotation(1);
  oled.setTextSize(1);  
  oled.setTextColor(WHITE);
  oled.setCursor(5, 13);
  oled.print(voltage);
  oled.print(" V");
  oled.setCursor(5, 28);
  oled.print(current);
  oled.print(" A");
  oled.setCursor(5, 43);

  oled.print(power);
  oled.print(" W");
  oled.setCursor(5, 1);
  oled.print(kwh);
  oled.print(" kWh");
  oled.setCursor(5, 118);
  oled.print("Pi Energy");
  oled.drawBitmap(6, 65, pico, 50, 50, WHITE);
  //oled.drawBitmap(10, 80, d, 32, 32, WHITE);
  oled.display();
  delay(3000);
  
  }


float getCorriente()
{
 float Volt_diferencial;
 float corriente;
 float sum = 0;
 long tiempo = millis();
 int counter = 0;
 
 while (millis() - tiempo < 1000)
 {
   Volt_diferencial = ads.readADC_Differential_2_3() * multiplier;
   

   corriente = Volt_diferencial * FACTOR;
   corriente /= 1000.0;
 
   sum += sq(corriente);
   counter = counter + 1;
  }
 
 corriente = sqrt(sum / counter);
 return(corriente);
}


void setup() {
  
  
   Wire.setSDA(4);
   Wire.setSCL(5);
   Wire1.setSDA(2);
   Wire1.setSCL(3);
  
   Wire.begin();
   Wire1.begin();
   Serial.begin(BAUD_RATE);
  
     //oled.begin(SSD1306_SWITCHCAPVCC, SCREEN_ADDRESS);
   if (!oled.begin(SSD1306_SWITCHCAPVCC, SCREEN_ADDRESS )) {
    Serial.println(F("SSD1306 allocation failed"));
    for (;;); // Don't proceed, loop forever
  }
   
   
   ads.begin();
   


  /* Wire1.setSDA(8);
   Wire1.setSCL(9);
   Wire1.begin();*/
   
   ads.setGain(GAIN_ONE);        // ±2.048V  1 bit = 0.0625mV
   ads.begin();
   pinMode(led, OUTPUT);

   voltageSensor.setSensitivity(SENSITIVITY);

    uart_init(UART_ID, BAUD_RATE);
    gpio_set_function(UART_TX_PIN, GPIO_FUNC_UART);
    gpio_set_function(UART_RX_PIN, GPIO_FUNC_UART);

      // Configurar una interrupción para recibir datos UART
    uart_set_irq_enables(UART_ID, true, false);
    irq_set_exclusive_handler(UART0_IRQ, uart_rx_callback);
    irq_set_enabled(UART0_IRQ, true);
}

void loop() {
  voltage = voltageSensor.getRmsVoltage();
  current = getCorriente();


  power = voltage * current;
  kwh = power /100;
  send_data_uart(voltage, current, power, kwh);
  Serial.println(current);
  sleep_ms(1000); // Esperar 3 segundos antes de enviar los siguientes datos

  myoled();
 
}